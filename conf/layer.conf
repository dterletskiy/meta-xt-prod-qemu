## conf/layer.conf
```bitbake
BBPATH .= ":${LAYERDIR}"

BBFILES += "${LAYERDIR}/recipes*/*/*.bb ${LAYERDIR}/recipes*/*/*.bbappend"

BBFILE_COLLECTIONS += "epam-layer"
BBFILE_PATTERN_epam-layer := "^${LAYERDIR}/"
BBFILE_PRIORITY_epam-layer = "8"

LICENSE_PATH += "${LAYERDIR}/files/custom-licenses"

LAYERVERSION_epam-layer = "1"
LAYERSERIES_COMPAT_epam-layer = "nanbield scarthgap"
LAYERDEPENDS_epam-layer = " \
    core \
    openembedded-layer \
    networking-layer \
    filesystems-layer \
    meta-python \
"

LAYERRECOMMENDS_epam-layer = " \
"
```

## layers/meta-xt-domx-qemu/conf/layer.conf
```bitbake
# We have a conf and classes directory, add to BBPATH
BBPATH .= ":${LAYERDIR}"

# We have a packages directory, add to BBFILES
BBFILES += "${LAYERDIR}/recipes-*/*/*.bb \
"

BBFILES_DYNAMIC += " \
virtualization-layer:${LAYERDIR}/recipes-extended/xen/*.bbappend \
"

BBFILE_COLLECTIONS += "xt-domx-qemu"
BBFILE_PATTERN_xt-domx-qemu := "^${LAYERDIR}/"
BBFILE_PRIORITY_xt-domx-qemu = "12"

LAYERSERIES_COMPAT_xt-domx-qemu = "scarthgap"
```

## recipes-extended/xen/files/defconfig
```kconfig
CONFIG_XSM=y
CONFIG_TEE=y
CONFIG_OPTEE=y
CONFIG_IPMMU_VMSA=y
CONFIG_IOREQ_SERVER=y
CONFIG_PCI_PASSTHROUGH=y
CONFIG_VIRTIO_PCI=y
CONFIG_EXPERT=y
CONFIG_RCAR4=y

CONFIG_ARM_SMMU_V3=y
```
